## firmware/c6/zigbee_router/main/Kconfig.projbuild
```kconfig
# Same Zigbee options as the esp-zigbee-sdk examples; esp-zigbee-lib reads them.
menu "Zigbee"

    config ZB_ENABLED
        bool "Zigbee Enable"
        default n

    choice ZB_DEVICE_TYPE
        prompt "Configure the Zigbee device type"
        depends on ZB_ENABLED
        default ZB_ZCZR

        config ZB_ZCZR
            bool "Zigbee Coordinator or Router device"

        config ZB_ZED
            bool "Zigbee End Device"
    endchoice

    choice ZB_RADIO_TYPE
        prompt "Configure the Zigbee radio type"
        depends on ZB_ENABLED
        default ZB_RADIO_NATIVE

        config ZB_RADIO_NATIVE
            bool "Native 15.4 radio"

        config ZB_RADIO_SPINEL_UART
            bool "Connect to 15.4 radio via Radio Spinel UART"
            select OPENTHREAD_SPINEL_ONLY
    endchoice

endmenu
```

## firmware/gateway/main/Kconfig.projbuild
```kconfig
menu "P4 gateway"

    config GW_HOSTNAME_PREFIX
        string "Hostname prefix (the last 3 MAC bytes are appended)"
        default "p4gw"

    config GW_DEFAULT_ROLE
        string "Role used on first boot (thread_br, thread_router, zigbee_coordinator, zigbee_router)"
        default "thread_br"

    config GW_OTBR_REST_PORT
        int "OTBR REST API port (Home Assistant OTBR integration)"
        default 8081

    config GW_ZIGBEE_TCP_PORT
        int "Zigbee NCP TCP port (Zigbee2MQTT / ZHA)"
        default 6638

    config GW_C6_UART_PORT
        int "UART to the C6 (shared by RCP, NCP and the flasher)"
        default 1

    config GW_C6_UART_TX
        int "P4 GPIO to C6 U0RXD (JP1 13 -> 20)"
        default 4

    config GW_C6_UART_RX
        int "P4 GPIO from C6 U0TXD (JP1 15 -> 22)"
        default 5

    config GW_C6_UART_BAUD
        int "Runtime baud rate (ot_rcp and zigbee_ncp are built for it)"
        default 460800

    config GW_C6_RESET_GPIO
        int "P4 GPIO driving C6 CHIP_PU (inside the module)"
        default 54

    config GW_C6_BOOT_GPIO
        int "P4 GPIO driving C6 IO9 / BOOT (JP1 17 -> 24)"
        default 20

    config GW_RADIO_B_UART_PORT
        int "UART to the external radio B (XIAO ESP32-C5 on JP1, docs/dual-radio.md)"
        default 2

    config GW_RADIO_B_UART_TX
        int "P4 GPIO to radio B RX (JP1 19 -> XIAO D7)"
        default 32

    config GW_RADIO_B_UART_RX
        int "P4 GPIO from radio B TX (JP1 21 <- XIAO D6)"
        default 33

    config GW_RADIO_B_RESET_GPIO
        int "P4 GPIO driving radio B reset (JP1 12 -> XIAO RST pad)"
        default 46

    config GW_RADIO_B_BOOT_GPIO
        int "P4 GPIO driving radio B boot (JP1 10 -> XIAO BOOT pad)"
        default 47

    config GW_ETH_PHY_RST_GPIO
        int "IP101 reset GPIO"
        default 51

    config GW_ETH_PHY_ADDR
        int "IP101 PHY address"
        default 1

endmenu
```
